## impl/Kconfig
```kconfig
# Copyright 2016, Data61, CSIRO (ABN 41 687 119 230)
#
# SPDX-License-Identifier: BSD-2-Clause

# This file defines the Kconfig menu structure.

mainmenu "Project Configuration"

menu "seL4 Kernel"
source "kernel/Kconfig"
endmenu

config COMMON_PATH
    string
    option env="COMMON_PATH"

source libs/Kconfig
source apps/Kconfig
source tools/elfloader/Kconfig
source "$COMMON_PATH/Kconfig"
```

## impl/apps/Kconfig
```kconfig
#
# Copyright 2014, NICTA
#
# This software may be distributed and modified according to the terms of
# the BSD 2-Clause license. Note that NO WARRANTY is provided.
# See "LICENSE_BSD2.txt" for details.
#
# @TAG(NICTA_BSD)
#

config SEL4_APPS_PATH
    string
    option env="SEL4_APPS_PATH"

menu "seL4 RefOS Applications"

source "$SEL4_APPS_PATH/process_server/Kconfig"
source "$SEL4_APPS_PATH/selfloader/Kconfig"
source "$SEL4_APPS_PATH/file_server/Kconfig"
source "$SEL4_APPS_PATH/console_server/Kconfig"
source "$SEL4_APPS_PATH/timer_server/Kconfig"
source "$SEL4_APPS_PATH/terminal/Kconfig"
source "$SEL4_APPS_PATH/test_os/Kconfig"
source "$SEL4_APPS_PATH/test_user/Kconfig"
source "$SEL4_APPS_PATH/tetris/Kconfig"
source "$SEL4_APPS_PATH/snake/Kconfig"
source "$SEL4_APPS_PATH/nethack/Kconfig"

endmenu

menu "seL4 RefOS Build Options"

    config REFOS_DEBUG
        bool "Enable RefOS debugging output."
        default n
        help
            Enable debug printing in RefOS.

    config REFOS_DEBUG_VERBOSE
        bool "Enable RefOS extra verbose debugging output. "
        default n
        help
            Enable extra verbose debug printing in RefOS.
            Useful for debugging low level.
            Beware of really long logs.

    config REFOS_RUN_TESTS
        bool "Run RefOS tests"
        default n
        help
            Run RefOS tests before starting the init task program.

    config REFOS_INIT_TASK
	string "RefOS app to launch on boot"
        default "terminal"
        help
            Which task should refOS start when it has bootstrapped

    config REFOS_INIT_TASK_PRIO
        int "RefOS init app priority (0-255)"
        default 50
        help
            seL4 priority to give to the init task

    config REFOS_ENABLE_EGA
        bool "Enable output to screen using EGA text mode."
        default y
        depends on PLAT_PC99 && LIB_VTERM
        help
            If enabled, RefOS will output stdout to EGA text mode on the screen, exposed by
            os_server as /dev/screen. Note that this only applies to RefOS userland and system apps,
            and do NOT enable any debug logs from the process server to be shown on the screen.
            Enable LIB_SEL4_PLAT_SUPPORT_X86_TEXT_EGA_PUTCHAR in libplatsupport for that.
            PC platform only.

    config REFOS_ANSI_COLOUR_OUTPUT
    bool "Enable ANSI escape sequenced colour output"
    depends on LIB_REFOS
    default y
    help
        Enable colour output using ANSI escape sequences. Disable if not outputting through serial
        to an ANSI-enabled terminal.

    config REFOS_HALT_ON_ERRNO
    bool "Halt on RefOS errno"
    default n
    help
        Enable stopping programming abrubtly on any errno set by RefOS syscalls. Useful for
        debugging.

    config REFOS_TIMEZONE
    string "System time zone"
    default "AEST-10"
    help
        The system default timezone in POSIX standard format.
        For further documentation, see
        http://www.gnu.org/software/libc/manual/html_node/TZ-Variable.html.

    choice
        prompt "Userland stdio dataspace"
        default REFOS_STDIO_DSPACE_SERIAL
        help
            Which dataspace to use as the default output. The screen output device is available on
            x86, when REFOS_ENABLE_EGA is enabled.

        config REFOS_STDIO_DSPACE_SERIAL
            bool "/dev_console/serial"
        config REFOS_STDIO_DSPACE_SCREEN
            bool "/dev_console/screen"
            depends on REFOS_ENABLE_EGA
    endchoice

    config REFOS_ENABLE_KEYBOARD
        bool "Enable input from PS2 keyboard."
        default n
        depends on PLAT_PC99
        help
            If enabled, RefOS will input stdin from PS2 keyboard drivers as well as serial in.

endmenu
```

## impl/apps/console_server/Kconfig
```kconfig
#
# Copyright 2016, Data61, CSIRO (ABN 41 687 119 230)
#
# SPDX-License-Identifier: BSD-2-Clause
#

config APP_CONSOLE_SERVER
    bool "RefOS Console Server"
    default y
    depends on LIB_SEL4 && HAVE_LIBC && LIB_SEL4_PLAT_SUPPORT && LIB_REFOS_SYS
    select HAVE_SEL4_APPS
    select APP_PROCESS_SERVER
    help
        Low level console server for Refos, which exposes a input/output consoel device
        for the system.
```

## impl/apps/file_server/Kconfig
```kconfig
#
# Copyright 2016, Data61, CSIRO (ABN 41 687 119 230)
#
# SPDX-License-Identifier: BSD-2-Clause
#

config APP_FILE_SERVER
    bool "RefOS File Server"
    default y
    depends on LIB_SEL4 && HAVE_LIBC && LIB_CPIO && LIB_ELF && LIB_REFOS_SYS
    select HAVE_SEL4_APPS
    select APP_PROCESS_SERVER
    help
        Simple file server for RefOS, which relies on DITE to pre-store files.
```

## impl/apps/nethack/Kconfig
```kconfig
#
# Copyright 2016, Data61, CSIRO (ABN 41 687 119 230)
#
# SPDX-License-Identifier: BSD-2-Clause
#

config APP_NETHACK
    bool "Nethack 3.4.3"
    default n
    depends on LIB_SEL4 && HAVE_LIBC && LIB_REFOS
    help
        Nethack on RefOS. This is a port of the classic roguelike game
        Nethack. Not all functionality may be available.
```

## impl/apps/process_server/Kconfig
```kconfig
#
# Copyright 2014, NICTA
#
# This software may be distributed and modified according to the terms of
# the BSD 2-Clause license. Note that NO WARRANTY is provided.
# See "LICENSE_BSD2.txt" for details.
#
# @TAG(NICTA_BSD)
#

menuconfig APP_PROCESS_SERVER
    bool "RefOS Process Server"
    default y
    depends on LIB_SEL4 && LIB_CPIO && LIB_REFOS 
    select HAVE_SEL4_APPS
    help
        RefOS Process Server application, which runs as the initial root task of the
        entire system. The process server is a trusted component; its responsible for starting
        and managing processes and threads, and hands the right capabilities to the right processes.
        The process server is required for the system to start.

config PROCSERV_INITIAL_MEM_SIZE
    int "Initial memory pool size"
    default 196608
    depends on APP_PROCESS_SERVER
    help
        Initial process server allocator memory pool. In order to solve cyclic allocation dependency
        problems, the allocator requires a static pre-allocated pool of memory in order to function.
        If this is set too high, too much memory will be reserved for book keeping and not enough
        RAM is left to be used to useful stuff. If this is set too low, the allocator runs out of
        memory to book keep the allocated objects, and starts failing object allocation before all
        the available RAM is used up.

config PROCSERV_MAX_VSPACES
    int "Max number of available page directories."
    default 64
    depends on APP_PROCESS_SERVER
    help
        Number of available statically allocated page directory objects. This is done to avoid
        allocator fragmentation, as kernel PD objects are quite big. They can easily fail to
        allocate if allocated dynamically. This number inheritly also limits the maximum number of
        processes available at once in the system. The actual number of processes available is
        MIN(PROCSERV_MAX_VSPACES, PROCSERV_MAX_PROCESSES).
```

## impl/apps/selfloader/Kconfig
```kconfig
#
# Copyright 2016, Data61, CSIRO (ABN 41 687 119 230)
#
# SPDX-License-Identifier: BSD-2-Clause
#

config APP_SELF_LOADER
    bool "RefOS Self Loader"
    default y
    depends on LIB_SEL4 && HAVE_LIBC && LIB_REFOS_SYS
    select HAVE_SEL4_APPS
    select APP_PROCESS_SERVER
    help
        Self loader code for loading processes. Starts in the staring process' own vspace,
        and loads the process's ELF segments from within. Needed to start RefOS userland processes.
```

## impl/apps/snake/Kconfig
```kconfig
#
# Copyright 2016, Data61, CSIRO (ABN 41 687 119 230)
#
# SPDX-License-Identifier: BSD-2-Clause
#

config APP_SNAKE
    bool "Snake"
    default y
    depends on LIB_SEL4 && HAVE_LIBC && LIB_REFOS
    help
        Snake game for RefOS. Drawing done using ANSI.
        The Snake game is a demo for RefOS, showcasing UNIX-like dataspace
        printf, input functionality, and timer sleep functionality.
```

## impl/apps/terminal/Kconfig
```kconfig
#
# Copyright 2016, Data61, CSIRO (ABN 41 687 119 230)
#
# SPDX-License-Identifier: BSD-2-Clause
#

config APP_TERMINAL
    bool "RefOS Terminal"
    default y
    depends on LIB_SEL4 && HAVE_LIBC && LIB_REFOS
    select HAVE_SEL4_APPS
    select APP_BOOTSTRAP
    select APP_FILE_SERVER
    select APP_PROCESS_SERVER
    help
        Simple terminal program for RefOS.
```

## impl/apps/test_os/Kconfig
```kconfig
#
# Copyright 2016, Data61, CSIRO (ABN 41 687 119 230)
#
# SPDX-License-Identifier: BSD-2-Clause
#

config APP_TEST_OS
    bool "RefOS OS Level Unit Tests"
    default y
    depends on LIB_SEL4 && HAVE_LIBC && LIB_REFOS
    help
        OS Level Unit tests for RefOS. These tests test that the bottom level RefOS environment
        is working. If this test fails, then bootloading is likely to fail, and userland tests
        may fail to even boot at all.
```

## impl/apps/test_user/Kconfig
```kconfig
#
# Copyright 2016, Data61, CSIRO (ABN 41 687 119 230)
#
# SPDX-License-Identifier: BSD-2-Clause
#

config APP_TEST_USER
    bool "RefOS User Level Unit Tests"
    default y
    depends on LIB_SEL4 && HAVE_LIBC && LIB_REFOS_SYS
    select HAVE_SEL4_APPS
    help
        Tests that test the bootstrapped RefOS userland environment is sane and usable.
        Tests include dynamic malloc() using both heap expansion and mmap, threads,
        IPC os_server printing, and so forth.
```

## impl/apps/tetris/Kconfig
```kconfig
#
# Copyright 2016, Data61, CSIRO (ABN 41 687 119 230)
#
# SPDX-License-Identifier: BSD-2-Clause
#

config APP_TETRIS
    bool "Tetris"
    default y
    depends on LIB_SEL4 && HAVE_LIBC && LIB_REFOS
    help
        Tetris game for RefOS. Drawing done using ANSI.
        The Tetris game is a demo for RefOS, showcasing UNIX-like dataspace
        printf, input functionality, and timer sleep functionality.
```

## impl/apps/timer_server/Kconfig
```kconfig
#
# Copyright 2014, NICTA
#
# This software may be distributed and modified according to the terms of
# the BSD 2-Clause license. Note that NO WARRANTY is provided.
# See "LICENSE_BSD2.txt" for details.
#
# @TAG(NICTA_BSD)
#

config APP_TIMER_SERVER
    bool "RefOS Timer Server"
    default y
    depends on LIB_SEL4 && HAVE_LIBC && LIB_SEL4_PLAT_SUPPORT && LIB_REFOS_SYS
    select HAVE_SEL4_APPS
    select APP_PROCESS_SERVER
    help
        Timer server for RefOS, which exposes simple timer functionality.
```

## impl/libs/Kconfig
```kconfig
#
# Copyright 2016, Data61, CSIRO (ABN 41 687 119 230)
#
# SPDX-License-Identifier: BSD-2-Clause
#

config SEL4_LIBS_PATH
    string
    option env="SEL4_LIBS_PATH"

menu "seL4 Libraries"

source "$SEL4_LIBS_PATH/libsel4/Kconfig"
source "$SEL4_LIBS_PATH/libcpio/Kconfig"
source "$SEL4_LIBS_PATH/libdatastruct/Kconfig"
source "$SEL4_LIBS_PATH/libelf/Kconfig"
source "$SEL4_LIBS_PATH/libmuslc/Kconfig"
source "$SEL4_LIBS_PATH/libsel4allocman/Kconfig"
source "$SEL4_LIBS_PATH/libsel4debug/Kconfig"
source "$SEL4_LIBS_PATH/libsel4muslcsys/Kconfig"
source "$SEL4_LIBS_PATH/libsel4platsupport/Kconfig"
source "$SEL4_LIBS_PATH/libsel4simple/Kconfig"
source "$SEL4_LIBS_PATH/libsel4simple-default/Kconfig"
source "$SEL4_LIBS_PATH/libsel4utils/Kconfig"
source "$SEL4_LIBS_PATH/libsel4vspace/Kconfig"
source "$SEL4_LIBS_PATH/libsel4vka/Kconfig"
source "$SEL4_LIBS_PATH/libsel4utils/Kconfig"
source "$SEL4_LIBS_PATH/librefossys/Kconfig"
source "$SEL4_LIBS_PATH/librefos/Kconfig"
source "$SEL4_LIBS_PATH/libutils/Kconfig"
source "$SEL4_LIBS_PATH/libvterm/Kconfig"
source "$SEL4_LIBS_PATH/libplatsupport/Kconfig"

endmenu
```

## impl/libs/libdatastruct/Kconfig
```kconfig
#
# Copyright 2016, Data61, CSIRO (ABN 41 687 119 230)
#
# SPDX-License-Identifier: BSD-2-Clause
#

config LIB_DATA_STRUCT
    bool "Build C Data Structures"
    depends on LIB_SEL4 && HAVE_LIBC
    default y
    help
        Helper library containing various data structures
        that are useful but aren't included in C stdlib.
        These include vectors, hash tables, free list
        allocation, bitfield allocation, and so forth.
```

## impl/libs/librefos/Kconfig
```kconfig
#
# Copyright 2016, Data61, CSIRO (ABN 41 687 119 230)
#
# SPDX-License-Identifier: BSD-2-Clause
#

menuconfig LIB_REFOS
    bool "RefOS System Library"
    depends on LIB_SEL4 && HAVE_LIBC && LIB_DATA_STRUCT
    default y
    help
        RefOS System Library, containing a vide variety of things from RPC communications headers
        to utility libraries. You'll most definitely want this enabled.
```

## impl/libs/librefossys/Kconfig
```kconfig
#
# Copyright 2014, NICTA
#
# This software may be distributed and modified according to the terms of
# the BSD 2-Clause license. Note that NO WARRANTY is provided.
# See "LICENSE_BSD2.txt" for details.
#
# @TAG(NICTA_BSD)
#

menuconfig LIB_REFOS_SYS
    bool "Syscall library for RefOS userland"
    default y
    depends on LIB_SEL4 && LIB_REFOS && HAVE_LIBC
    help
        Syscall library for RefOS  userland. This library is responsible for implementing simple
        POSIX environment syscalls on top of RefOS primitives. This allows for the C standard
        library to work and be happy, and also allows for easier porting.

config REFOS_SYS_FORCE_DEBUGPUTCHAR
    bool "Force seL4_DebugPutChar printf"
    default n
    depends on LIB_REFOS_SYS
    help
        Force RefOS userland to use seL4_DebugPutChar(), even when not needed. If this option is not
        set, IPC messages will be sent to the Console server. This allows a few more messages to
        print during initialisation, useful for debugging. Requires seL4 debug kernel.
```

## impl/libs/libvterm/Kconfig
```kconfig
#
# Copyright 2016, Data61, CSIRO (ABN 41 687 119 230)
#
# SPDX-License-Identifier: BSD-2-Clause
#

config LIB_VTERM
    bool "Virtual terminal library"
    depends on HAVE_LIBC
    default y
    help
        Port of libvterm by Paul "LeoNerd" Evans, a C99 virtual terminal emulator library released
        under the MIT license. As the library uses abstract C99 with no dependance on any POSIX or
        any rendering / UI system, no changes to the library code was required; only the build
        system has been adapted.
```
